## boards/nordic/test805/board.yml
```yaml
# Copyright (c) 2024 Nordic Semiconductor ASA
# SPDX-License-Identifier: Apache-2.0

board:
  name: test805
  vendor: nordic
  socs:
    - name: nrf52805
```

## boards/nordic/test805/test805_defconfig
```kconfig
# Copyright (c) 2024 Nordic Semiconductor ASA
# SPDX-License-Identifier: Apache-2.0

CONFIG_ARM_MPU=y
CONFIG_HW_STACK_PROTECTION=y
```

## boards/sctanf/sctanf_slimenrf/Kconfig.sctanf_slimenrf
```kconfig
# Copyright (c) 2023 Nordic Semiconductor ASA
# SPDX-License-Identifier: Apache-2.0

config BOARD_SCTANF_SLIMENRF
	select SOC_NRF52840_QIAA
```

## boards/sctanf/sctanf_slimenrf/board.yml
```yaml
# Copyright (c) 2024 Nordic Semiconductor ASA
# SPDX-License-Identifier: Apache-2.0

board:
  name: sctanf slimenrf
  vendor: nordic
  socs:
    - name: nrf52840
```

## boards/sctanf/sctanf_slimenrf_2/Kconfig.sctanf_slimenrf_2
```kconfig
# Copyright (c) 2023 Nordic Semiconductor ASA
# SPDX-License-Identifier: Apache-2.0

config BOARD_SCTANF_SLIMENRF_2
	select SOC_NRF52832_CIAA
```

## boards/sctanf/slimenrf_r2/Kconfig.slimenrf_r2
```kconfig
# Copyright (c) 2023 Nordic Semiconductor ASA
# SPDX-License-Identifier: Apache-2.0

config BOARD_SLIMENRF_R2
	select SOC_NRF52832_CIAA
```

## boards/sctanf/slimenrf_r2/board.yml
```yaml
# Copyright (c) 2024 Nordic Semiconductor ASA
# SPDX-License-Identifier: Apache-2.0

board:
  name: slimenrf_r2
  vendor: nordic
  socs:
    - name: nrf52832
```

## boards/sctanf/slimenrf_r3/board.yml
```yaml
# Copyright (c) 2024 Nordic Semiconductor ASA
# SPDX-License-Identifier: Apache-2.0

board:
  name: slimenrf_r3
  vendor: sctanf
  socs:
    - name: nrf52840
```

## boards/slimevr/slimevrmini_p1_uf2/board.yml
```yaml
# Copyright (c) 2024 Nordic Semiconductor ASA
# SPDX-License-Identifier: Apache-2.0

board:
  name: slimevrmini_p1_uf2
  vendor: slimevr
  socs:
    - name: nrf52833
```

## boards/vendor/sctanf_slimenrf/board.yml
```yaml
# Copyright (c) 2024 Nordic Semiconductor ASA
# SPDX-License-Identifier: Apache-2.0

board:
  name: sctanf slimenrf
  vendor: vendor
  socs:
    - name: nrf52840
```

## boards/vendor/sctanf_slimenrf_2/Kconfig.sctanf_slimenrf_2
```kconfig
# Copyright (c) 2023 Nordic Semiconductor ASA
# SPDX-License-Identifier: Apache-2.0

config BOARD_SCTANF_SLIMENRF_2
	select SOC_DCDC_NRF52X
	depends on SOC_NRF52832_CIAA
```

## boards/vendor/sctanf_slimenrf_2/board.yml
```yaml
# Copyright (c) 2024 Nordic Semiconductor ASA
# SPDX-License-Identifier: Apache-2.0

board:
  name: sctanf slimenrf 2
  vendor: vendor
  socs:
    - name: nrf52832
```

## boards/vendor/slimenrf_r3_uf2/board.yml
```yaml
# Copyright (c) 2024 Nordic Semiconductor ASA
# SPDX-License-Identifier: Apache-2.0

board:
  name: slimenrf_r3_uf2
  vendor: vendor
  socs:
    - name: nrf52840
```

## boards/vendor/slimevrmini_p1_uf2/board.yml
```yaml
# Copyright (c) 2024 Nordic Semiconductor ASA
# SPDX-License-Identifier: Apache-2.0

board:
  name: slimevrmini_p1_uf2
  vendor: vendor
  socs:
    - name: nrf52833
```

## boards/vendor/supermini_uf2/supermini_uf2_defconfig
```kconfig
# Copyright (c) 2024 Nordic Semiconductor ASA
# SPDX-License-Identifier: Apache-2.0

CONFIG_ARM_MPU=y
CONFIG_HW_STACK_PROTECTION=y

CONFIG_USB_DEVICE_STACK=y
CONFIG_USB_DEVICE_PRODUCT="SlimeNRF Tracker SuperMini"

CONFIG_BATTERY_USE_REG_LDO_MAPPING=y

#generate for adafruit uf2 bootloader flashing
CONFIG_BUILD_OUTPUT_UF2=y
CONFIG_FLASH_LOAD_OFFSET=0x1000
```

## boards/vendor/test805/board.yml
```yaml
# Copyright (c) 2024 Nordic Semiconductor ASA
# SPDX-License-Identifier: Apache-2.0

board:
  name: test805
  vendor: vendor
  socs:
    - name: nrf52805
```

## boards/vendor/xiao_uf2/board.yml
```yaml
# Copyright (c) 2024 Nordic Semiconductor ASA
# SPDX-License-Identifier: Apache-2.0

board:
  name: Xiao nRF52840 UF2
  vendor: vendor
  socs:
    - name: nrf52840
```
