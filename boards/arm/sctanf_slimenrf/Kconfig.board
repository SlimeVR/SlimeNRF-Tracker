## boards/arm/sctanf_slimenrf/Kconfig.board
```kconfig
# Copyright (c) 2023 Nordic Semiconductor ASA
# SPDX-License-Identifier: Apache-2.0

config BOARD_SCTANF_SLIMENRF
	bool "sctanf slimenrf"
	depends on SOC_NRF52840_QIAA
```

## boards/arm/sctanf_slimenrf/Kconfig.defconfig
```kconfig
# Copyright (c) 2023 Nordic Semiconductor ASA
# SPDX-License-Identifier: Apache-2.0

if BOARD_SCTANF_SLIMENRF

config BOARD
	default "sctanf_slimenrf"

config BT_CTLR
   default BT

endif
```

## boards/arm/sctanf_slimenrf_2/Kconfig.board
```kconfig
# Copyright (c) 2023 Nordic Semiconductor ASA
# SPDX-License-Identifier: Apache-2.0

config BOARD_SCTANF_SLIMENRF_2
	bool "sctanf slimenrf 2"
	depends on SOC_NRF52832_CIAA
```

## boards/arm/sctanf_slimenrf_2/Kconfig.defconfig
```kconfig
# Copyright (c) 2023 Nordic Semiconductor ASA
# SPDX-License-Identifier: Apache-2.0

if BOARD_SCTANF_SLIMENRF_2

config BOARD
	default "sctanf_slimenrf_2"

config BT_CTLR
   default BT

endif
```

## boards/arm/sctanf_slimenrf_3/Kconfig.board
```kconfig
# Copyright (c) 2023 Nordic Semiconductor ASA
# SPDX-License-Identifier: Apache-2.0

config BOARD_SCTANF_SLIMENRF_3
	bool "sctanf slimenrf 3"
	depends on SOC_NRF52811_QFAA
```

## boards/arm/sctanf_slimenrf_3/Kconfig.defconfig
```kconfig
# Copyright (c) 2023 Nordic Semiconductor ASA
# SPDX-License-Identifier: Apache-2.0

if BOARD_SCTANF_SLIMENRF_3

config BOARD
	default "sctanf_slimenrf_3"

config BT_CTLR
   default BT

endif
```

## boards/arm/slimenrf_r3/Kconfig.board
```kconfig
# Copyright (c) 2024 Nordic Semiconductor ASA
# SPDX-License-Identifier: Apache-2.0

config BOARD_SLIMENRF_R3
	bool "slimenrf_r3"
	depends on SOC_NRF52840_QIAA
```

## boards/arm/slimenrf_r3/Kconfig.defconfig
```kconfig
# Copyright (c) 2024 Nordic Semiconductor ASA
# SPDX-License-Identifier: Apache-2.0

if BOARD_SLIMENRF_R3

config BOARD
	default "slimenrf_r3"

config BT_CTLR
   default BT


endif
```

## boards/arm/slimenrf_r3/slimenrf_r3_defconfig
```kconfig
# Copyright (c) 2024 Nordic Semiconductor ASA
# SPDX-License-Identifier: Apache-2.0

CONFIG_SOC_SERIES_NRF52X=y
CONFIG_SOC_NRF52840_QIAA=y
CONFIG_BOARD_SLIMENRF_R3=y

# Enable MPU
CONFIG_ARM_MPU=y

# Enable hardware stack protection
CONFIG_HW_STACK_PROTECTION=y

CONFIG_USB_DEVICE_STACK=y
CONFIG_USB_DEVICE_PRODUCT="SlimeNRF Tracker R3"

CONFIG_BATTERY_USE_REG_BUCK_MAPPING=y
```

## boards/arm/slimenrf_r3_uf2/Kconfig.board
```kconfig
# Copyright (c) 2024 Nordic Semiconductor ASA
# SPDX-License-Identifier: Apache-2.0

config BOARD_SLIMENRF_R3_UF2
	bool "slimenrf_r3_uf2"
	select SOC_DCDC_NRF52X
	depends on SOC_NRF52840_QIAA
```

## boards/arm/slimenrf_r3_uf2/Kconfig.defconfig
```kconfig
# Copyright (c) 2024 Nordic Semiconductor ASA
# SPDX-License-Identifier: Apache-2.0

if BOARD_SLIMENRF_R3_UF2

config BOARD
	default "slimenrf_r3_uf2"

config BT_CTLR
   default BT


endif
```

## boards/arm/slimevrmini_p1_uf2/Kconfig.board
```kconfig
# Copyright (c) 2024 Nordic Semiconductor ASA
# SPDX-License-Identifier: Apache-2.0

config BOARD_SLIMEVRMINI_P1_UF2
	bool "slimevrmini_p1_uf2"
	select SOC_DCDC_NRF52X
	depends on SOC_NRF52833_QIAA
```

## boards/arm/slimevrmini_p1_uf2/Kconfig.defconfig
```kconfig
# Copyright (c) 2024 Nordic Semiconductor ASA
# SPDX-License-Identifier: Apache-2.0

if BOARD_SLIMEVRMINI_P1_UF2

config BOARD
	default "slimevrmini_p1_uf2"

config BT_CTLR
   default BT


endif
```

## boards/arm/slimevrmini_p1_uf2/slimevrmini_p1_uf2_defconfig
```kconfig
# Copyright (c) 2024 Nordic Semiconductor ASA
# SPDX-License-Identifier: Apache-2.0

CONFIG_SOC_SERIES_NRF52X=y
CONFIG_SOC_NRF52833_QIAA=y
CONFIG_BOARD_SLIMEVRMINI_P1_UF2=y

# Enable MPU
CONFIG_ARM_MPU=y

# Enable hardware stack protection
CONFIG_HW_STACK_PROTECTION=y

CONFIG_USB_DEVICE_STACK=y
CONFIG_USB_DEVICE_PRODUCT="SlimeVR Mini Tracker P1"

#generate for adafruit uf2 bootloader flashing
CONFIG_BUILD_OUTPUT_UF2=y
CONFIG_FLASH_LOAD_OFFSET=0x1000
```

## boards/arm/supermini/Kconfig.defconfig
```kconfig
# Copyright (c) 2024 Nordic Semiconductor ASA
# SPDX-License-Identifier: Apache-2.0

if BOARD_SUPERMINI

config BOARD
	default "supermini"

config BT_CTLR
   default BT


endif
```

## boards/arm/supermini_uf2/Kconfig.defconfig
```kconfig
# Copyright (c) 2024 Nordic Semiconductor ASA
# SPDX-License-Identifier: Apache-2.0

if BOARD_SUPERMINI_UF2

config BOARD
	default "supermini_uf2"

config BT_CTLR
   default BT


endif
```

## boards/arm/supermini_uf2/supermini_uf2_defconfig
```kconfig
# Copyright (c) 2024 Nordic Semiconductor ASA
# SPDX-License-Identifier: Apache-2.0

CONFIG_SOC_SERIES_NRF52X=y
CONFIG_SOC_NRF52840_QIAA=y
CONFIG_BOARD_SUPERMINI_UF2=y

# Enable MPU
CONFIG_ARM_MPU=y

# Enable hardware stack protection
CONFIG_HW_STACK_PROTECTION=y

CONFIG_USB_DEVICE_STACK=y
CONFIG_USB_DEVICE_PRODUCT="SlimeNRF Tracker SuperMini"

CONFIG_BATTERY_USE_REG_LDO_MAPPING=y

#generate for adafruit uf2 bootloader flashing
CONFIG_BUILD_OUTPUT_UF2=y
CONFIG_FLASH_LOAD_OFFSET=0x1000
```

## boards/arm/test805/Kconfig.board
```kconfig
# Copyright (c) 2024 Nordic Semiconductor ASA
# SPDX-License-Identifier: Apache-2.0

config BOARD_TEST805
	bool "test805"
	depends on SOC_NRF52805_CAAA
```

## boards/arm/test805/Kconfig.defconfig
```kconfig
# Copyright (c) 2024 Nordic Semiconductor ASA
# SPDX-License-Identifier: Apache-2.0

if BOARD_TEST805

config BOARD
	default "test805"

config BT_CTLR
   default BT


endif
```

## boards/arm/xiao_uf2/Kconfig.defconfig
```kconfig
# Copyright (c) 2024 Nordic Semiconductor ASA
# SPDX-License-Identifier: Apache-2.0

if BOARD_XIAO_UF2

config BOARD
	default "xiao_uf2"

config BT_CTLR
   default BT


endif
```

## boards/nordic/sctanf_slimenrf_2/sctanf_slimenrf_2_defconfig
```kconfig
# Copyright (c) 2023 Nordic Semiconductor ASA
# SPDX-License-Identifier: Apache-2.0

CONFIG_ARM_MPU=y
CONFIG_HW_STACK_PROTECTION=y

CONFIG_USB_DEVICE_STACK=n

CONFIG_BATTERY_USE_REG_BUCK_MAPPING=y
```

## boards/nordic/slimenrf_r3/board.yml
```yaml
# Copyright (c) 2024 Nordic Semiconductor ASA
# SPDX-License-Identifier: Apache-2.0

board:
  name: slimenrf_r3
  vendor: nordic
  socs:
    - name: nrf52840
```

## boards/nordic/slimenrf_r3/slimenrf_r3_defconfig
```kconfig
# Copyright (c) 2024 Nordic Semiconductor ASA
# SPDX-License-Identifier: Apache-2.0

CONFIG_ARM_MPU=y
CONFIG_HW_STACK_PROTECTION=y

CONFIG_USB_DEVICE_STACK=y
CONFIG_USB_DEVICE_PRODUCT="SlimeNRF Tracker R3"

CONFIG_BATTERY_USE_REG_BUCK_MAPPING=y
```

## boards/nordic/supermini_uf2/Kconfig.supermini_uf2
```kconfig
# Copyright (c) 2024 Nordic Semiconductor ASA
# SPDX-License-Identifier: Apache-2.0

config BOARD_SUPERMINI_UF2
	select SOC_DCDC_NRF52X
	depends on SOC_NRF52840_QIAA
```

## boards/nordic/supermini_uf2/board.yml
```yaml
# Copyright (c) 2024 Nordic Semiconductor ASA
# SPDX-License-Identifier: Apache-2.0

board:
  name: supermini_uf2
  vendor: nordic
  socs:
    - name: nrf52840
```
